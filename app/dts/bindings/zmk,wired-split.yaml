## app/dts/bindings/zmk,wired-split.yaml
```yaml
# Copyright (c) 2024 The ZMK Contributors
# SPDX-License-Identifier: MIT

description: |
  Complete specification of wired split connetion

compatible: "zmk,wired-split"

properties:
  device:
    type: phandle
    required: true
    description: The UART device for wired split communication

  half-duplex:
    type: boolean
    description: Enable half-duplex protocol mode.

  dir-gpios:
    type: phandle-array
```

## app/src/split/wired/Kconfig.defaults
```kconfig
if ZMK_SPLIT_WIRED

config ZMK_SPLIT_WIRED_CMD_BUFFER_ITEMS
    default 4

config ZMK_SPLIT_WIRED_EVENT_BUFFER_ITEMS
    default 16


if ZMK_SPLIT_WIRED_UART_MODE_DEFAULT_POLLING

config ZMK_SPLIT_WIRED_POLLING_RX_PERIOD
    default 10

endif


if ZMK_SPLIT_WIRED_UART_MODE_DEFAULT_ASYNC

config ZMK_SPLIT_WIRED_ASYNC_RX_TIMEOUT
    default 20

endif

config ZMK_SPLIT_WIRED_HALF_DUPLEX_RX_TIMEOUT
    default 15

config ZMK_SPLIT_WIRED_HALF_DUPLEX_RX_COMPLETE_TIMEOUT
    default 20

endif
```
